## CMakeLists.txt
```
# SPDX-FileCopyrightText: 2026 Secure Legacy Gateway contributors
# SPDX-License-Identifier: Apache-2.0

cmake_minimum_required(VERSION 3.20.0)

find_package(Zephyr REQUIRED HINTS $ENV{ZEPHYR_BASE})

project(mcx_http_test)

target_sources(app PRIVATE
    src/main.c
    src/html_stream.c
    src/proxy_request.c
)

target_sources_ifdef(CONFIG_MCUX_PSA_CRYPTO_DRIVER_ELS_PKC app PRIVATE
    src/els_psa_selftest.c
)

set(gen_dir ${ZEPHYR_BINARY_DIR}/include/generated/)

generate_inc_file_for_target(
    app
    src/globalsign_r1.der
    ${gen_dir}/globalsign_r1.der.inc
)

generate_inc_file_for_target(
    app
    src/aaa_certificate_services.der
    ${gen_dir}/aaa_certificate_services.der.inc
)

generate_inc_file_for_target(
    app
    src/isrg_root_x1.der
    ${gen_dir}/isrg_root_x1.der.inc
)

generate_inc_file_for_target(
    app
    src/globalsign_root_r3.der
    ${gen_dir}/globalsign_root_r3.der.inc
)
```

## prj.conf
```kconfig
# SPDX-FileCopyrightText: 2026 Secure Legacy Gateway contributors
# SPDX-License-Identifier: Apache-2.0

CONFIG_NETWORKING=y
CONFIG_NET_IPV4=y
CONFIG_NET_IPV6=n
CONFIG_NET_ARP=y
CONFIG_NET_TCP=y
CONFIG_NET_UDP=y
CONFIG_NET_SOCKETS=y
CONFIG_NET_CONFIG_SETTINGS=y
CONFIG_NET_CONFIG_AUTO_INIT=y
CONFIG_NET_CONFIG_NEED_IPV4=y
# DHCP-only network profile for use with different routers and subnets.
CONFIG_NET_IF_UNICAST_IPV4_ADDR_COUNT=1
CONFIG_NET_DHCPV4=y
CONFIG_NET_DHCPV4_INITIAL_DELAY_MAX=2
# Some routers and Ethernet MACs cannot deliver a unicast DHCPOFFER before
# the client owns an IPv4 address.  Request broadcast replies for maximum
# compatibility across validation networks.
CONFIG_NET_DHCPV4_ACCEPT_UNICAST=n
CONFIG_NET_CONFIG_INIT_TIMEOUT=60
CONFIG_NET_CONFIG_MY_IPV4_NETMASK=""
CONFIG_LOG=y
CONFIG_NET_LOG=y
CONFIG_PRINTK=y
CONFIG_NET_SHELL=y
CONFIG_SHELL=y
CONFIG_MAIN_STACK_SIZE=8192
# getaddrinfo() allocates its result array from the Zephyr system heap.
CONFIG_HEAP_MEM_POOL_SIZE=4096

# TLS / HTTPS
CONFIG_MBEDTLS=y
CONFIG_MBEDTLS_ENABLE_HEAP=y
# Two simultaneous TLS client contexts need separate 16 KiB input/output
# record buffers. Reserve enough Mbed TLS heap for both handshakes.
CONFIG_MBEDTLS_HEAP_SIZE=114688
CONFIG_NET_SOCKETS_SOCKOPT_TLS=y
CONFIG_NET_SOCKETS_TLS_MAX_CONTEXTS=2
CONFIG_NET_SOCKETS_TLS_MAX_SESSION_CONTEXTS=2
CONFIG_NET_SOCKETS_TLS_MAX_CLIENT_SESSION_COUNT=2
CONFIG_NET_SOCKETS_TLS_MAX_CREDENTIALS=7
CONFIG_TLS_MAX_CREDENTIALS_NUMBER=7
CONFIG_ENTROPY_GENERATOR=y

# TLS client / TLS 1.2

# TLS 1.2 + cipher suite for Zephyr 4.4
CONFIG_MBEDTLS_SSL_PROTO_TLS1_2=y

# DNS
CONFIG_DNS_RESOLVER=y
CONFIG_DNS_SERVER_IP_ADDRESSES=n
CONFIG_NET_DHCPV4_OPTION_DNS_ADDRESS=y
CONFIG_NET_DHCPV4_DNS_SERVER_VIA_INTERFACE=y
CONFIG_DNS_NUM_CONCUR_QUERIES=4
# Keep enough resolver work buffers for all configured query slots.
CONFIG_DNS_RESOLVER_ADDITIONAL_BUF_CTR=4
CONFIG_DNS_RESOLVER_CACHE=y
CONFIG_DNS_RESOLVER_CACHE_MAX_ENTRIES=8
CONFIG_DNS_RESOLVER_MAX_NAME_LEN=128

# Match Zephyr official http_get TLS sample
# Allow full-size TLS records from general HTTPS servers.
CONFIG_MBEDTLS_SSL_MAX_CONTENT_LEN=16384
CONFIG_MBEDTLS_HASH_ALL_ENABLED=y
CONFIG_PSA_WANT_ALG_CMAC=y
CONFIG_PSA_WANT_ALG_SHA_1=y

# Match Zephyr official http_get TLS sample
CONFIG_MBEDTLS_CIPHERSUITE_TLS_ECDHE_RSA_WITH_AES_128_CBC_SHA256=y

CONFIG_MBEDTLS_CIPHERSUITE_TLS_ECDHE_RSA_WITH_AES_128_GCM_SHA256=y

# TLS debug

CONFIG_MBEDTLS_CIPHERSUITE_TLS_ECDHE_ECDSA_WITH_AES_128_GCM_SHA256=y

CONFIG_MBEDTLS_SSL_SERVER_NAME_INDICATION=y

CONFIG_PSA_WANT_ECC_SECP_R1_384=y

# IE 5 opens several short-lived parallel connections while DNS and the
# listening socket are also active.  Keep spare TCP contexts so a new HTTPS
# socket can be created before recently closed connections are fully released.
CONFIG_NET_MAX_CONN=12
CONFIG_NET_MAX_CONTEXTS=12
# Enforce the per-client request deadline used by the proxy.
CONFIG_NET_CONTEXT_RCVTIMEO=y
CONFIG_NET_CONTEXT_SNDTIMEO=y
# Keep a stalled legacy client from holding a worker indefinitely.
CONFIG_NET_SOCKET_MAX_SEND_WAIT=10000
# The proxy actively closes every short-lived HTTP connection. Avoid retaining
# scarce contexts in TIME_WAIT, as done by Zephyr's HTTP server samples.
CONFIG_NET_TCP_TIME_WAIT_DELAY=0

CONFIG_MBEDTLS_ECP_NIST_OPTIM=y

# Keep one full Ethernet frame in one net_buf. The ENET driver reserves
# 16 RX buffers for its DMA descriptors. Apple-class pages can keep both
# proxy workers and a few pending client sockets active at once, so retain
# 20 additional buffers for the IP/TCP stack while keeping each TCP receive
# window bounded at 4 KiB.
CONFIG_NET_BUF_DATA_SIZE=1536
CONFIG_NET_BUF_RX_COUNT=36
CONFIG_NET_BUF_TX_COUNT=16
CONFIG_NET_PKT_RX_COUNT=24
CONFIG_NET_PKT_TX_COUNT=24
CONFIG_NET_TCP_MAX_RECV_WINDOW_SIZE=4096
```

## els_psa.conf
```kconfig
# SPDX-FileCopyrightText: 2026 Secure Legacy Gateway contributors
# SPDX-License-Identifier: Apache-2.0

# Full NXP ELS/PKC PSA profile.  PSA dispatch can offload symmetric crypto,
# hashing/MAC, key agreement, signatures and key generation to ELS/PKC.
CONFIG_MCUX_ELS_PKC=y
CONFIG_MCUX_PSA_CRYPTO_DRIVER_ELS_PKC=y
CONFIG_MCUX_PSA_CRYPTO_DRIVER_ELS_PKC_THREAD=y

# Explicitly keep the algorithms needed by the self-test and TLS 1.2 suites.
CONFIG_PSA_WANT_ALG_GCM=y
CONFIG_PSA_WANT_KEY_TYPE_AES=y
```

## software_crypto.conf
```kconfig
# SPDX-FileCopyrightText: 2026 Secure Legacy Gateway contributors
# SPDX-License-Identifier: Apache-2.0

# Portable software-crypto profile. TLS and PSA remain enabled by prj.conf.
# This file deliberately does not enable CONFIG_MCUX_ELS_PKC or
# CONFIG_MCUX_PSA_CRYPTO_DRIVER_ELS_PKC, so cryptographic operations use the
# software implementation. The board's hardware ELS TRNG remains enabled as
# its cryptographically secure entropy source.
```

## app.overlay
```dts
/* SPDX-FileCopyrightText: 2026 Secure Legacy Gateway contributors */
/* SPDX-License-Identifier: Apache-2.0 */

/*
 * Derive a stable Ethernet address from the MCX device UUID.  The Zephyr
 * binding documents this as suitable for development and demos; a commercial
 * product should use MAC addresses assigned by its manufacturer.
 */
&enet_mac {
	/delete-property/ zephyr,random-mac-address;
	nxp,unique-mac;
};
```

## src/els_psa_selftest.c
```c
/* SPDX-FileCopyrightText: 2026 Secure Legacy Gateway contributors */
/* SPDX-License-Identifier: Apache-2.0 */

#include "els_psa_selftest.h"

#include <psa/crypto.h>
#include <zephyr/logging/log.h>

#include <string.h>

LOG_MODULE_REGISTER(els_psa_selftest, LOG_LEVEL_INF);

static int test_aes_gcm(void)
{
    static const uint8_t key[16] = {0};
    static const uint8_t nonce[12] = {0};
    static const uint8_t plaintext[16] = {0};
    static const uint8_t expected[32] = {
        0x03, 0x88, 0xda, 0xce, 0x60, 0xb6, 0xa3, 0x92,
        0xf3, 0x28, 0xc2, 0xb9, 0x71, 0xb2, 0xfe, 0x78,
        0xab, 0x6e, 0x47, 0xd4, 0x2c, 0xec, 0x13, 0xbd,
        0xf5, 0x3a, 0x67, 0xb2, 0x12, 0x57, 0xbd, 0xdf,
    };
    psa_key_attributes_t attributes = PSA_KEY_ATTRIBUTES_INIT;
    psa_key_id_t key_id = PSA_KEY_ID_NULL;
    uint8_t encrypted[sizeof(expected)];
    uint8_t decrypted[sizeof(plaintext)];
    size_t encrypted_length = 0;
    size_t decrypted_length = 0;
    psa_status_t status;

    psa_set_key_type(&attributes, PSA_KEY_TYPE_AES);
    psa_set_key_bits(&attributes, 128);
    psa_set_key_usage_flags(&attributes,
                            PSA_KEY_USAGE_ENCRYPT | PSA_KEY_USAGE_DECRYPT);
    psa_set_key_algorithm(&attributes, PSA_ALG_GCM);

    status = psa_import_key(&attributes, key, sizeof(key), &key_id);
    psa_reset_key_attributes(&attributes);
    if (status != PSA_SUCCESS) {
        LOG_ERR("PSA AES key import failed: %d", status);
        return -1;
    }

    status = psa_aead_encrypt(key_id, PSA_ALG_GCM,
                              nonce, sizeof(nonce),
                              NULL, 0,
                              plaintext, sizeof(plaintext),
                              encrypted, sizeof(encrypted),
                              &encrypted_length);
    if (status != PSA_SUCCESS || encrypted_length != sizeof(expected) ||
        memcmp(encrypted, expected, sizeof(expected)) != 0) {
        LOG_ERR("ELS PSA AES-GCM encryption self-test failed: %d", status);
        psa_destroy_key(key_id);
        return -1;
    }

    status = psa_aead_decrypt(key_id, PSA_ALG_GCM,
                              nonce, sizeof(nonce),
                              NULL, 0,
                              encrypted, encrypted_length,
                              decrypted, sizeof(decrypted),
                              &decrypted_length);
    if (status != PSA_SUCCESS || decrypted_length != sizeof(plaintext) ||
        memcmp(decrypted, plaintext, sizeof(plaintext)) != 0) {
        LOG_ERR("ELS PSA AES-GCM decryption self-test failed: %d", status);
        psa_destroy_key(key_id);
        return -1;
    }

    status = psa_destroy_key(key_id);
    if (status != PSA_SUCCESS) {
        LOG_ERR("PSA AES key cleanup failed: %d", status);
        return -1;
    }

    LOG_INF("ELS PSA AES-128-GCM hardware self-test PASS");
    return 0;
}

static int test_sha256(void)
{
    static const uint8_t message[] = {'a', 'b', 'c'};
    static const uint8_t expected[32] = {
        0xba, 0x78, 0x16, 0xbf, 0x8f, 0x01, 0xcf, 0xea,
        0x41, 0x41, 0x40, 0xde, 0x5d, 0xae, 0x22, 0x23,
        0xb0, 0x03, 0x61, 0xa3, 0x96, 0x17, 0x7a, 0x9c,
        0xb4, 0x10, 0xff, 0x61, 0xf2, 0x00, 0x15, 0xad,
    };
    uint8_t hash[sizeof(expected)];
    size_t hash_length = 0;
    psa_status_t status;

    status = psa_hash_compute(PSA_ALG_SHA_256,
                              message, sizeof(message),
                              hash, sizeof(hash), &hash_length);
    if (status != PSA_SUCCESS || hash_length != sizeof(expected) ||
        memcmp(hash, expected, sizeof(expected)) != 0) {
        LOG_ERR("ELS/PKC PSA SHA-256 self-test failed: %d", status);
        return -1;
    }

    LOG_INF("ELS/PKC PSA SHA-256 self-test PASS");
    return 0;
}

static int test_aes_cmac(void)
{
    static const uint8_t key[16] = {
        0x2b, 0x7e, 0x15, 0x16, 0x28, 0xae, 0xd2, 0xa6,
        0xab, 0xf7, 0x15, 0x88, 0x09, 0xcf, 0x4f, 0x3c,
    };
    static const uint8_t message[16] = {
        0x6b, 0xc1, 0xbe, 0xe2, 0x2e, 0x40, 0x9f, 0x96,
        0xe9, 0x3d, 0x7e, 0x11, 0x73, 0x93, 0x17, 0x2a,
    };
    static const uint8_t expected[16] = {
        0x07, 0x0a, 0x16, 0xb4, 0x6b, 0x4d, 0x41, 0x44,
        0xf7, 0x9b, 0xdd, 0x9d, 0xd0, 0x4a, 0x28, 0x7c,
    };
    psa_key_attributes_t attributes = PSA_KEY_ATTRIBUTES_INIT;
    psa_key_id_t key_id = PSA_KEY_ID_NULL;
    uint8_t mac[sizeof(expected)];
    size_t mac_length = 0;
    psa_status_t status;

    psa_set_key_type(&attributes, PSA_KEY_TYPE_AES);
    psa_set_key_bits(&attributes, 128);
    psa_set_key_usage_flags(&attributes, PSA_KEY_USAGE_SIGN_MESSAGE);
    psa_set_key_algorithm(&attributes, PSA_ALG_CMAC);

    status = psa_import_key(&attributes, key, sizeof(key), &key_id);
    psa_reset_key_attributes(&attributes);
    if (status != PSA_SUCCESS) {
        LOG_ERR("PSA CMAC key import failed: %d", status);
        return -1;
    }

    status = psa_mac_compute(key_id, PSA_ALG_CMAC,
                             message, sizeof(message),
                             mac, sizeof(mac), &mac_length);
    if (status != PSA_SUCCESS || mac_length != sizeof(expected) ||
        memcmp(mac, expected, sizeof(expected)) != 0) {
        LOG_ERR("ELS/PKC PSA AES-CMAC self-test failed: %d", status);
        psa_destroy_key(key_id);
        return -1;
    }

    status = psa_destroy_key(key_id);
    if (status != PSA_SUCCESS) {
        LOG_ERR("PSA CMAC key cleanup failed: %d", status);
        return -1;
    }

    LOG_INF("ELS/PKC PSA AES-CMAC self-test PASS");
    return 0;
}

static int test_ecdh_p256(void)
{
    psa_key_attributes_t attributes = PSA_KEY_ATTRIBUTES_INIT;
    psa_key_id_t key_a = PSA_KEY_ID_NULL;
    psa_key_id_t key_b = PSA_KEY_ID_NULL;
    uint8_t public_a[65];
    uint8_t public_b[65];
    uint8_t shared_a[32];
    uint8_t shared_b[32];
    size_t public_a_length = 0;
    size_t public_b_length = 0;
    size_t shared_a_length = 0;
    size_t shared_b_length = 0;
    psa_status_t status;
    int result = -1;

    psa_set_key_type(&attributes,
                     PSA_KEY_TYPE_ECC_KEY_PAIR(PSA_ECC_FAMILY_SECP_R1));
    psa_set_key_bits(&attributes, 256);
    psa_set_key_usage_flags(&attributes, PSA_KEY_USAGE_DERIVE);
    psa_set_key_algorithm(&attributes, PSA_ALG_ECDH);

    status = psa_generate_key(&attributes, &key_a);
    if (status != PSA_SUCCESS) {
        LOG_ERR("ELS/PKC PSA ECDH key A generation failed: %d", status);
        goto cleanup;
    }

    status = psa_generate_key(&attributes, &key_b);
    psa_reset_key_attributes(&attributes);
    if (status != PSA_SUCCESS) {
        LOG_ERR("ELS/PKC PSA ECDH key B generation failed: %d", status);
        goto cleanup;
    }

    status = psa_export_public_key(key_a, public_a, sizeof(public_a),
                                   &public_a_length);
    if (status != PSA_SUCCESS) {
        LOG_ERR("PSA ECDH public key A export failed: %d", status);
        goto cleanup;
    }

    status = psa_export_public_key(key_b, public_b, sizeof(public_b),
                                   &public_b_length);
    if (status != PSA_SUCCESS) {
        LOG_ERR("PSA ECDH public key B export failed: %d", status);
        goto cleanup;
    }

    status = psa_raw_key_agreement(PSA_ALG_ECDH, key_a,
                                   public_b, public_b_length,
                                   shared_a, sizeof(shared_a),
                                   &shared_a_length);
    if (status != PSA_SUCCESS) {
        LOG_ERR("ELS/PKC PSA ECDH agreement A failed: %d", status);
        goto cleanup;
    }

    status = psa_raw_key_agreement(PSA_ALG_ECDH, key_b,
                                   public_a, public_a_length,
                                   shared_b, sizeof(shared_b),
                                   &shared_b_length);
    if (status != PSA_SUCCESS || shared_a_length != sizeof(shared_a) ||
        shared_b_length != shared_a_length ||
        memcmp(shared_a, shared_b, shared_a_length) != 0) {
        LOG_ERR("ELS/PKC PSA ECDH shared-secret self-test failed: %d", status);
        goto cleanup;
    }

    LOG_INF("ELS/PKC PSA P-256 ECDH self-test PASS");
    result = 0;

cleanup:
    psa_reset_key_attributes(&attributes);
    if (key_a != PSA_KEY_ID_NULL) {
        psa_destroy_key(key_a);
    }
    if (key_b != PSA_KEY_ID_NULL) {
        psa_destroy_key(key_b);
    }
    return result;
}

static int test_ecdsa_p256(void)
{
    static const uint8_t hash[32] = {
        0xba, 0x78, 0x16, 0xbf, 0x8f, 0x01, 0xcf, 0xea,
        0x41, 0x41, 0x40, 0xde, 0x5d, 0xae, 0x22, 0x23,
        0xb0, 0x03, 0x61, 0xa3, 0x96, 0x17, 0x7a, 0x9c,
        0xb4, 0x10, 0xff, 0x61, 0xf2, 0x00, 0x15, 0xad,
    };
    const psa_algorithm_t algorithm = PSA_ALG_ECDSA(PSA_ALG_SHA_256);
    psa_key_attributes_t attributes = PSA_KEY_ATTRIBUTES_INIT;
    psa_key_id_t key_id = PSA_KEY_ID_NULL;
    uint8_t signature[64];
    size_t signature_length = 0;
    psa_status_t status;

    psa_set_key_type(&attributes,
                     PSA_KEY_TYPE_ECC_KEY_PAIR(PSA_ECC_FAMILY_SECP_R1));
    psa_set_key_bits(&attributes, 256);
    psa_set_key_usage_flags(&attributes,
                            PSA_KEY_USAGE_SIGN_HASH | PSA_KEY_USAGE_VERIFY_HASH);
    psa_set_key_algorithm(&attributes, algorithm);

    status = psa_generate_key(&attributes, &key_id);
    psa_reset_key_attributes(&attributes);
    if (status != PSA_SUCCESS) {
        LOG_ERR("ELS/PKC PSA ECDSA key generation failed: %d", status);
        return -1;
    }

    status = psa_sign_hash(key_id, algorithm,
                           hash, sizeof(hash),
                           signature, sizeof(signature), &signature_length);
    if (status != PSA_SUCCESS) {
        LOG_ERR("ELS/PKC PSA ECDSA signing failed: %d", status);
        psa_destroy_key(key_id);
        return -1;
    }

    status = psa_verify_hash(key_id, algorithm,
                             hash, sizeof(hash),
                             signature, signature_length);
    if (status != PSA_SUCCESS) {
        LOG_ERR("ELS/PKC PSA ECDSA verification failed: %d", status);
        psa_destroy_key(key_id);
        return -1;
    }

    status = psa_destroy_key(key_id);
    if (status != PSA_SUCCESS) {
        LOG_ERR("PSA ECDSA key cleanup failed: %d", status);
        return -1;
    }

    LOG_INF("ELS/PKC PSA P-256 ECDSA sign/verify self-test PASS");
    return 0;
}

int els_psa_selftest(void)
{
    psa_status_t status = psa_crypto_init();

    if (status != PSA_SUCCESS) {
        LOG_ERR("PSA initialization failed: %d", status);
        return -1;
    }

    if (test_aes_gcm() != 0 ||
        test_sha256() != 0 ||
        test_aes_cmac() != 0 ||
        test_ecdh_p256() != 0 ||
        test_ecdsa_p256() != 0) {
        LOG_ERR("ELS/PKC PSA full-profile self-test FAILED");
        return -1;
    }

    LOG_INF("ELS/PKC PSA full-profile self-test: ALL PASS");
    return 0;
}
```

## src/els_psa_selftest.h
```c
/* SPDX-FileCopyrightText: 2026 Secure Legacy Gateway contributors */
/* SPDX-License-Identifier: Apache-2.0 */

#ifndef ELS_PSA_SELFTEST_H
#define ELS_PSA_SELFTEST_H

int els_psa_selftest(void);

#endif
```

## src/html_stream.c
```c
/* SPDX-FileCopyrightText: 2026 Secure Legacy Gateway contributors */
/* SPDX-License-Identifier: Apache-2.0 */

#include "html_stream.h"

#include <errno.h>
#include <stdint.h>
#include <string.h>

static const char https_prefix[] = "https://";
static const char http_prefix[] = "http://";

static int buffered_write(struct html_rewriter *rewriter,
                          const char *data,
                          size_t length)
{
    while (length > 0) {
        size_t available = sizeof(rewriter->output) - rewriter->output_length;
        size_t copy = length < available ? length : available;

        memcpy(rewriter->output + rewriter->output_length, data, copy);
        rewriter->output_length += copy;
        data += copy;
        length -= copy;

        if (rewriter->output_length == sizeof(rewriter->output)) {
            int ret = rewriter->write(rewriter->context, rewriter->output,
                                      rewriter->output_length);
            if (ret < 0) {
                return ret;
            }
            rewriter->output_length = 0;
        }
    }

    return 0;
}

void html_rewriter_init(struct html_rewriter *rewriter,
                        stream_write_fn write,
                        void *context)
{
    memset(rewriter, 0, sizeof(*rewriter));
    rewriter->write = write;
    rewriter->context = context;
}

int html_rewriter_feed(struct html_rewriter *rewriter,
                       const char *data,
                       size_t length)
{
    for (size_t i = 0; i < length; i++) {
        char byte = data[i];

        if (byte == https_prefix[rewriter->pending_length]) {
            rewriter->pending[rewriter->pending_length++] = byte;
            if (rewriter->pending_length == sizeof(https_prefix) - 1) {
                int ret = buffered_write(rewriter, http_prefix,
                                         sizeof(http_prefix) - 1);
                if (ret < 0) {
                    return ret;
                }
                rewriter->pending_length = 0;
                rewriter->replacements++;
            }
            continue;
        }

        if (rewriter->pending_length > 0) {
            int ret = buffered_write(rewriter, rewriter->pending,
                                     rewriter->pending_length);
            if (ret < 0) {
                return ret;
            }
            rewriter->pending_length = 0;

            if (byte == https_prefix[0]) {
                rewriter->pending[rewriter->pending_length++] = byte;
                continue;
            }
        }

        int ret = buffered_write(rewriter, &byte, 1);
        if (ret < 0) {
            return ret;
        }
    }

    return 0;
}

int html_rewriter_finish(struct html_rewriter *rewriter)
{
    if (rewriter->pending_length > 0) {
        int ret = buffered_write(rewriter, rewriter->pending,
                                 rewriter->pending_length);
        if (ret < 0) {
            return ret;
        }
        rewriter->pending_length = 0;
    }

    if (rewriter->output_length > 0) {
        int ret = rewriter->write(rewriter->context, rewriter->output,
                                  rewriter->output_length);
        if (ret < 0) {
            return ret;
        }
        rewriter->output_length = 0;
    }

    return 0;
}

static int hex_value(char byte)
{
    if (byte >= '0' && byte <= '9') {
        return byte - '0';
    }
    if (byte >= 'a' && byte <= 'f') {
        return byte - 'a' + 10;
    }
    if (byte >= 'A' && byte <= 'F') {
        return byte - 'A' + 10;
    }
    return -1;
}

void chunk_decoder_init(struct chunk_decoder *decoder,
                        stream_write_fn write,
                        void *context)
{
    memset(decoder, 0, sizeof(*decoder));
    decoder->state = CHUNK_DECODE_SIZE;
    decoder->write = write;
    decoder->context = context;
}

int chunk_decoder_feed(struct chunk_decoder *decoder,
                       const char *data,
                       size_t length)
{
    size_t pos = 0;

    while (pos < length) {
        char byte = data[pos];

        switch (decoder->state) {
        case CHUNK_DECODE_SIZE: {
            if (++decoder->line_length > HTTP_CHUNK_LINE_LIMIT) {
                return -EOVERFLOW;
            }
            if (byte == '\r') {
                if (!decoder->have_digit) {
                    return -EINVAL;
                }
                decoder->state = CHUNK_DECODE_SIZE_LF;
                pos++;
                break;
            }
            if (byte == '\n') {
                return -EINVAL;
            }
            if (decoder->in_extension) {
                pos++;
                break;
            }
            if (byte == ';') {
                if (!decoder->have_digit) {
                    return -EINVAL;
                }
                decoder->in_extension = true;
                pos++;
                break;
            }
            int value = hex_value(byte);
            if (value < 0 ||
                decoder->chunk_size > (SIZE_MAX - (size_t)value) / 16) {
                return -EINVAL;
            }
            decoder->have_digit = true;
            decoder->chunk_size = decoder->chunk_size * 16 + (size_t)value;
            pos++;
            break;
        }

        case CHUNK_DECODE_SIZE_LF:
            if (byte != '\n') {
                return -EINVAL;
            }
            pos++;
            decoder->line_length = 0;
            if (decoder->chunk_size == 0) {
                decoder->state = CHUNK_DECODE_TRAILER_START;
            } else {
                decoder->chunk_remaining = decoder->chunk_size;
                decoder->state = CHUNK_DECODE_DATA;
            }
            break;

        case CHUNK_DECODE_DATA: {
            size_t available = length - pos;
            size_t take = decoder->chunk_remaining < available
                        ? decoder->chunk_remaining : available;
            int ret = decoder->write(decoder->context, data + pos, take);
            if (ret < 0) {
                return ret;
            }
            pos += take;
            decoder->chunk_remaining -= take;
            if (decoder->chunk_remaining == 0) {
                decoder->state = CHUNK_DECODE_DATA_CR;
            }
            break;
        }

        case CHUNK_DECODE_DATA_CR:
            if (byte != '\r') {
                return -EINVAL;
            }
            decoder->state = CHUNK_DECODE_DATA_LF;
            pos++;
            break;

        case CHUNK_DECODE_DATA_LF:
            if (byte != '\n') {
                return -EINVAL;
            }
            decoder->state = CHUNK_DECODE_SIZE;
            decoder->chunk_size = 0;
            decoder->have_digit = false;
            decoder->in_extension = false;
            pos++;
            break;

        case CHUNK_DECODE_TRAILER_START:
            if (byte == '\r') {
                decoder->state = CHUNK_DECODE_TRAILER_FINAL_LF;
            } else if (byte == '\n') {
                return -EINVAL;
            } else {
                decoder->line_length = 1;
                decoder->state = CHUNK_DECODE_TRAILER_LINE;
            }
            pos++;
            break;

        case CHUNK_DECODE_TRAILER_LINE:
            if (byte == '\r') {
                decoder->state = CHUNK_DECODE_TRAILER_LINE_LF;
            } else if (byte == '\n' ||
                       ++decoder->line_length > HTTP_CHUNK_LINE_LIMIT) {
                return -EINVAL;
            }
            pos++;
            break;

        case CHUNK_DECODE_TRAILER_LINE_LF:
            if (byte != '\n') {
                return -EINVAL;
            }
            decoder->line_length = 0;
            decoder->state = CHUNK_DECODE_TRAILER_START;
            pos++;
            break;

        case CHUNK_DECODE_TRAILER_FINAL_LF:
            if (byte != '\n') {
                return -EINVAL;
            }
            decoder->state = CHUNK_DECODE_DONE;
            pos++;
            break;

        case CHUNK_DECODE_DONE:
            return -EINVAL;
        }
    }

    return 0;
}

bool chunk_decoder_complete(const struct chunk_decoder *decoder)
{
    return decoder->state == CHUNK_DECODE_DONE;
}

int chunk_decoder_finish(const struct chunk_decoder *decoder)
{
    return chunk_decoder_complete(decoder) ? 0 : -EAGAIN;
}
```

## src/html_stream.h
```c
/* SPDX-FileCopyrightText: 2026 Secure Legacy Gateway contributors */
/* SPDX-License-Identifier: Apache-2.0 */

#ifndef HTML_STREAM_H
#define HTML_STREAM_H

#include <stdbool.h>
#include <stddef.h>
#include <stdint.h>

#define HTML_REWRITE_OUTPUT_SIZE 1024
#define HTTP_CHUNK_LINE_LIMIT 1024

typedef int (*stream_write_fn)(void *context, const char *data, size_t length);

struct html_rewriter {
    stream_write_fn write;
    void *context;
    char pending[8];
    size_t pending_length;
    char output[HTML_REWRITE_OUTPUT_SIZE];
    size_t output_length;
    size_t replacements;
};

void html_rewriter_init(struct html_rewriter *rewriter,
                        stream_write_fn write,
                        void *context);
int html_rewriter_feed(struct html_rewriter *rewriter,
                       const char *data,
                       size_t length);
int html_rewriter_finish(struct html_rewriter *rewriter);

enum chunk_decode_state {
    CHUNK_DECODE_SIZE,
    CHUNK_DECODE_SIZE_LF,
    CHUNK_DECODE_DATA,
    CHUNK_DECODE_DATA_CR,
    CHUNK_DECODE_DATA_LF,
    CHUNK_DECODE_TRAILER_START,
    CHUNK_DECODE_TRAILER_LINE,
    CHUNK_DECODE_TRAILER_LINE_LF,
    CHUNK_DECODE_TRAILER_FINAL_LF,
    CHUNK_DECODE_DONE,
};

struct chunk_decoder {
    enum chunk_decode_state state;
    stream_write_fn write;
    void *context;
    size_t chunk_size;
    size_t chunk_remaining;
    size_t line_length;
    bool have_digit;
    bool in_extension;
};

void chunk_decoder_init(struct chunk_decoder *decoder,
                        stream_write_fn write,
                        void *context);
int chunk_decoder_feed(struct chunk_decoder *decoder,
                       const char *data,
                       size_t length);
bool chunk_decoder_complete(const struct chunk_decoder *decoder);
int chunk_decoder_finish(const struct chunk_decoder *decoder);

#endif
```

## src/proxy_request.c
```c
/* SPDX-FileCopyrightText: 2026 Secure Legacy Gateway contributors */
/* SPDX-License-Identifier: Apache-2.0 */

#include "proxy_request.h"

#include <stdint.h>
#include <string.h>
#include <strings.h>

static size_t find_header_length(const char *data, size_t length)
{
    if (length < 4) {
        return 0;
    }

    for (size_t i = 3; i < length; i++) {
        if (data[i - 3] == '\r' && data[i - 2] == '\n' &&
            data[i - 1] == '\r' && data[i] == '\n') {
            return i + 1;
        }
    }

    return 0;
}

bool proxy_request_header_complete(const char *data, size_t length)
{
    return find_header_length(data, length) != 0;
}

static bool valid_host(const char *host, size_t length)
{
    if (length == 0 || host[0] == '.' || host[0] == '-' ||
        host[length - 1] == '.' || host[length - 1] == '-') {
        return false;
    }

    for (size_t i = 0; i < length; i++) {
        char byte = host[i];
        bool alpha = (byte >= 'a' && byte <= 'z') ||
                     (byte >= 'A' && byte <= 'Z');
        bool digit = byte >= '0' && byte <= '9';
        if (!alpha && !digit && byte != '.' && byte != '-') {
            return false;
        }
    }

    return true;
}

static bool parse_decimal(const char *value, const char *end, size_t *result)
{
    size_t parsed = 0;

    while (value < end && (*value == ' ' || *value == '\t')) {
        value++;
    }
    const char *start = value;
    while (value < end && *value >= '0' && *value <= '9') {
        unsigned int digit = (unsigned int)(*value++ - '0');
        if (parsed > (SIZE_MAX - digit) / 10) {
            return false;
        }
        parsed = parsed * 10 + digit;
    }
    while (value < end && (*value == ' ' || *value == '\t')) {
        value++;
    }
    if (value == start || value != end) {
        return false;
    }
    *result = parsed;
    return true;
}

static bool media_type_is_form(const char *value, const char *end)
{
    static const char form[] = "application/x-www-form-urlencoded";

    while (value < end && (*value == ' ' || *value == '\t')) {
        value++;
    }
    if ((size_t)(end - value) < sizeof(form) - 1 ||
        strncasecmp(value, form, sizeof(form) - 1) != 0) {
        return false;
    }
    value += sizeof(form) - 1;
    while (value < end && (*value == ' ' || *value == '\t')) {
        value++;
    }
    return value == end || *value == ';';
}

static enum proxy_request_result parse_headers(const char *line,
                                                const char *header_end,
                                                struct proxy_request *request)
{
    bool have_content_length = false;
    bool form_content_type = false;

    while (line < header_end && *line != '\r') {
        const char *line_end = line;
        while (line_end + 1 < header_end &&
               !(line_end[0] == '\r' && line_end[1] == '\n')) {
            line_end++;
        }
        if (line_end + 1 >= header_end) {
            return PROXY_REQUEST_BAD;
        }

        const char *colon = memchr(line, ':', (size_t)(line_end - line));
        if (colon == NULL) {
            return PROXY_REQUEST_BAD;
        }
        const char *value = colon + 1;
        const char *value_end = line_end;
        while (value < value_end && (*value == ' ' || *value == '\t')) {
            value++;
        }
        while (value_end > value &&
               (value_end[-1] == ' ' || value_end[-1] == '\t')) {
            value_end--;
        }

        size_t name_length = (size_t)(colon - line);
        if (name_length == sizeof("User-Agent") - 1 &&
            strncasecmp(line, "User-Agent", name_length) == 0 &&
            request->user_agent[0] == '\0') {
            size_t value_length = (size_t)(value_end - value);
            if (value_length >= sizeof(request->user_agent)) {
                value_length = sizeof(request->user_agent) - 1;
            }
            bool valid = true;
            for (size_t i = 0; i < value_length; i++) {
                unsigned char byte = (unsigned char)value[i];
                if ((byte < 0x20 && byte != '\t') || byte == 0x7f) {
                    valid = false;
                    break;
                }
            }
            if (valid) {
                memcpy(request->user_agent, value, value_length);
                request->user_agent[value_length] = '\0';
            }
        } else if (name_length == sizeof("Content-Length") - 1 &&
                   strncasecmp(line, "Content-Length", name_length) == 0) {
            if (have_content_length ||
                !parse_decimal(value, value_end, &request->content_length)) {
                return PROXY_REQUEST_BAD;
            }
            have_content_length = true;
        } else if (name_length == sizeof("Content-Type") - 1 &&
                   strncasecmp(line, "Content-Type", name_length) == 0) {
            form_content_type = media_type_is_form(value, value_end);
        } else if (name_length == sizeof("Transfer-Encoding") - 1 &&
                   strncasecmp(line, "Transfer-Encoding", name_length) == 0) {
            return PROXY_REQUEST_UNSUPPORTED_TRANSFER_ENCODING;
        }

        line = line_end + 2;
    }

    if (request->method == PROXY_METHOD_POST) {
        if (!have_content_length) {
            return PROXY_REQUEST_LENGTH_REQUIRED;
        }
        if (request->content_length > PROXY_POST_MAX_BODY_SIZE) {
            return PROXY_REQUEST_PAYLOAD_TOO_LARGE;
        }
        if (!form_content_type) {
            return PROXY_REQUEST_UNSUPPORTED_MEDIA_TYPE;
        }
    }

    return PROXY_REQUEST_OK;
}

enum proxy_request_result proxy_request_parse(const char *data,
                                              size_t length,
                                              struct proxy_request *request)
{
    memset(request, 0, sizeof(*request));

    size_t header_length = find_header_length(data, length);
    if (header_length == 0 ||
        memchr(data, '\0', header_length) != NULL) {
        return PROXY_REQUEST_BAD;
    }
    request->header_length = header_length;

    const char *line_end = NULL;
    for (size_t i = 1; i < length; i++) {
        if (data[i - 1] == '\r' && data[i] == '\n') {
            line_end = data + i - 1;
            break;
        }
    }
    if (line_end == NULL) {
        return PROXY_REQUEST_BAD;
    }

    const char *first_space = memchr(data, ' ', (size_t)(line_end - data));
    if (first_space == NULL) {
        return PROXY_REQUEST_BAD;
    }
    size_t method_length = (size_t)(first_space - data);
    if (method_length == 3 && memcmp(data, "GET", 3) == 0) {
        request->method = PROXY_METHOD_GET;
    } else if (method_length == 4 && memcmp(data, "HEAD", 4) == 0) {
        request->method = PROXY_METHOD_HEAD;
    } else if (method_length == 4 && memcmp(data, "POST", 4) == 0) {
        request->method = PROXY_METHOD_POST;
    } else {
        return PROXY_REQUEST_METHOD_NOT_ALLOWED;
    }

    const char *target = first_space + 1;
    const char *second_space = memchr(target, ' ',
                                      (size_t)(line_end - target));
    if (second_space == NULL || second_space == target) {
        return PROXY_REQUEST_BAD;
    }

    const char *version = second_space + 1;
    size_t version_length = (size_t)(line_end - version);
    if (version_length != 8 ||
        (memcmp(version, "HTTP/1.0", 8) != 0 &&
         memcmp(version, "HTTP/1.1", 8) != 0)) {
        return PROXY_REQUEST_BAD;
    }

    size_t target_length = (size_t)(second_space - target);
    if (target_length < 8 || strncasecmp(target, "http://", 7) != 0) {
        return PROXY_REQUEST_UNSUPPORTED_TARGET;
    }
    if (memchr(target, '#', target_length) != NULL) {
        return PROXY_REQUEST_BAD;
    }

    const char *authority = target + 7;
    const char *target_end = second_space;
    const char *path = target_end;
    for (const char *p = authority; p < target_end; p++) {
        if (*p == '/' || *p == '?') {
            path = p;
            break;
        }
    }

    const char *host_end = path;
    const char *colon = memchr(authority, ':', (size_t)(host_end - authority));
    if (colon != NULL) {
        if (memchr(colon + 1, ':', (size_t)(host_end - colon - 1)) != NULL ||
            (size_t)(host_end - colon - 1) != 2 ||
            memcmp(colon + 1, "80", 2) != 0) {
            return PROXY_REQUEST_UNSUPPORTED_TARGET;
        }
        host_end = colon;
    }

    size_t host_length = (size_t)(host_end - authority);
    if (!valid_host(authority, host_length)) {
        return PROXY_REQUEST_BAD;
    }
    if (host_length >= sizeof(request->host)) {
        return PROXY_REQUEST_URI_TOO_LONG;
    }
    memcpy(request->host, authority, host_length);
    request->host[host_length] = '\0';

    if (path == target_end) {
        memcpy(request->path, "/", 2);
    } else {
        size_t path_length = (size_t)(target_end - path);
        size_t prefix_length = *path == '?' ? 1 : 0;
        if (path_length + prefix_length >= sizeof(request->path)) {
            return PROXY_REQUEST_URI_TOO_LONG;
        }
        if (prefix_length != 0) {
            request->path[0] = '/';
        }
        memcpy(request->path + prefix_length, path, path_length);
        request->path[path_length + prefix_length] = '\0';
    }

    return parse_headers(line_end + 2, data + header_length, request);
}
```

## src/proxy_request.h
```c
/* SPDX-FileCopyrightText: 2026 Secure Legacy Gateway contributors */
/* SPDX-License-Identifier: Apache-2.0 */

#ifndef PROXY_REQUEST_H
#define PROXY_REQUEST_H

#include <stdbool.h>
#include <stddef.h>

#define PROXY_REQUEST_HEADER_SIZE 2048
#define PROXY_HOST_SIZE 128
#define PROXY_PATH_SIZE 1024
#define PROXY_USER_AGENT_SIZE 192
#define PROXY_POST_MAX_BODY_SIZE 16384

enum proxy_request_result {
    PROXY_REQUEST_OK = 0,
    PROXY_REQUEST_BAD = -1,
    PROXY_REQUEST_METHOD_NOT_ALLOWED = -2,
    PROXY_REQUEST_UNSUPPORTED_TARGET = -3,
    PROXY_REQUEST_URI_TOO_LONG = -4,
    PROXY_REQUEST_LENGTH_REQUIRED = -5,
    PROXY_REQUEST_PAYLOAD_TOO_LARGE = -6,
    PROXY_REQUEST_UNSUPPORTED_MEDIA_TYPE = -7,
    PROXY_REQUEST_UNSUPPORTED_TRANSFER_ENCODING = -8,
};

enum proxy_request_method {
    PROXY_METHOD_GET,
    PROXY_METHOD_HEAD,
    PROXY_METHOD_POST,
};

struct proxy_request {
    enum proxy_request_method method;
    char host[PROXY_HOST_SIZE];
    char path[PROXY_PATH_SIZE];
    char user_agent[PROXY_USER_AGENT_SIZE];
    size_t header_length;
    size_t content_length;
};

bool proxy_request_header_complete(const char *data, size_t length);
enum proxy_request_result proxy_request_parse(const char *data,
                                              size_t length,
                                              struct proxy_request *request);

#endif
```
